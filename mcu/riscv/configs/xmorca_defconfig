## mcu/riscv/configs/xmorca_defconfig
```kconfig
CONFIG_PLATFORM  = xmorca
CONFIG_PLATFORM_XMORCA  = y
CONFIG_CFLAGS    = "-march=rv32imafc -mabi=ilp32f -mtune=e906 -Wall -Os"
CONFIG_LDFLAGS   = "--oformat=elf32-littleriscv -lm -L$(shell $(CC) -print-sysroot)/lib/rv32imafc/ilp32f/ -lgcc -L$(dir $(shell $(CC) $(CFLAGS) -print-libgcc-file-name))"

CONFIG_PRINT = y
#CONFIG_PRINTF = y
#CONFIG_SERIAL_DISABLE = y
#CONFIG_DEBUG_INFO = y
CONFIG_MALLOC = y
CONFIG_MCU_FW_MAGIC = 0x57465652
CONFIG_MCU_FW_VERSION = 1
CONFIG_MCU_SRAM_SIZE = 208*1024
CONFIG_MCU_HEAD_SIZE = 64
CONFIG_TEXT_BASE = 0x401C000
CONFIG_STAGE2_START = 0x4028000
CONFIG_STACK_SIZE = 8192
CONFIG_PARAM_MEM_SIZE = 4096
CONFIG_RESERVED_MEM_SIZE = (1 * 1024 * 1024)
#CONFIG_FPGA = y
CONFIG_I2C = y
CONFIG_BIN_END_PAD = 0xdeadbeef
CONFIG_PWM = y
#CONFIG_SIMPILE_SHELL = y
##CONFIG_UT_ENABLE = y
#CONFIG_XTHEAD_ISA_EXT = y
CONFIG_MEDIA_SUPPORT = y
#CONFIG_STOPWATCH_SUPPORT = y
CONFIG_MEDIA_PIPE_NUM = 1
#CONFIG_MEDIA_SAMPLE_QUICKSTART = y
```

## source/bootloader/product/driver/Kconfig
```kconfig
menu "Product driver set"

config CMD_VO_DRIVER
        bool "Support VO driver"
        default n

config MIPI_LCD_SUPPORT
        bool "Support MIPI screen parameter set"
        depends on CMD_VO_DRIVER
        default n

config MCU_LCD_SUPPORT
        bool "Support MCU screen parameter set"
        depends on CMD_VO_DRIVER
        default n

endmenu

source "product/driver/ssp/Kconfig"
```

## source/bootloader/product/driver/ssp/Kconfig
```kconfig
menu "Support ssp lcd set"

config CMD_LCD_ST7789
        bool "Support lcd st7789 init cmd"
        depends on SPI
        default n

endmenu
```

## source/bootloader/u-boot-2020.01/lotus/Kconfig
```kconfig
menu "Lotus SoCs Configuration"

if ARCH_LOTUS

source "lotus/machine/Kconfig"

config TINY_BOOT
	bool "Enable Tiny boot support"
	default n
	help
	  Support for lotus tiny boot solution.

config QS_MCU
	bool "Support AE MCU firmware"
	default n
	help
	  Support filling AE MCU firmware to boot and loading it

config LOTUS_EDA
	bool "Enable EDA support"
	default n
	help
	  Support for EDA simulation.

config LOTUS_FPGA
	bool "Enable FPGA support"
	default n
	help
	  Support for FPGA debug.

config LOTUS_GZIP_BOOT
	bool "Use GZIP compressed boot"
	default y
	help
	  Use GZIP compressed boot.

config LOTUS_DISABLE_CONSOLE
	bool "Disable console"
	default n
	help
	  This will disable the console, it may be useful in the final product
          for security or quick starting resons.

config AUXCODE_LOG_CTRL
	int "Auxcode log control"
	default 1
	help
	  0 - no log
	  1 - use bootrom info level otp
	  2 - show all log

config LOTUS_DISABLE_DOWNLOAD
	bool "Disable downloading from PC tools"
	default n
	help
	  This will disable downloading function from the PC side, it may be useful
          in the final product for security or low-cost flash resons.

config AUXCODE_SVB_CTRL
	hex "Auxcode SVB control"
	default 0
	help
	  0 - Enable SVB
	  0xC35A3CA5 - Disable SVB

config HWDEC
	bool "Enable Hardward Decompressing Support"
	default y if TARGET_XMFALCON
	default y if TARGET_XMORCA
	depends on TARGET_XMFALCON || TARGET_XMORCA
	help
	  Support hardware decompressing.

config GCAI_BAD_DDR
	bool "Enable GCAI Bad DDR Support"
	default n
	depends on TARGET_XMFALCON
	help
	  Support GCAI Bad DDR

config MMC_8BIT
	bool "Enable MMC 8 Bit Mode"
	default n
	depends on TARGET_XMFALCON || TARGET_XMORCA
	help
	  Support MMC 8 Bit

config DDR_PARAM_OFFSET
	hex "DDR Param Partition Offset"
	default 0xC0000
	depends on TARGET_XMORCA
	help
	  DDR param partition offset

config DDR_PARAM_SIZE
	hex "DDR Param Partition Size"
	default 0x80000
	depends on TARGET_XMORCA
	help
	  DDR param partition size

config SBL_SUPPORT
	bool "Enable Second Boot Loader(SBL) Support"
	default n
	help
	  Support Second Boot Loader(SBL)

config SBL_LOAD_ADDR
	hex "SBL Load Address"
	default 0x40700000
	depends on SBL_SUPPORT
	help
	  Second Boot Loader(SBL) Load Address in DDR

config SBL_SIZE
	hex "SBL Size"
	default 0x40000
	depends on SBL_SUPPORT
	help
	  Second Boot Loader(SBL) Image Size

config SBL_OFFSET
	hex "SBL Offset"
	default 0x40000
	depends on SBL_SUPPORT
	help
	  Second Boot Loader(SBL) Offset in Flash

source "lotus/drivers/Kconfig"

endif

endmenu
```

## source/bootloader/u-boot-2020.01/lotus/drivers/Kconfig
```kconfig
menu "Device drivers"

source "lotus/drivers/i2c/Kconfig"

source "lotus/drivers/usb/Kconfig"

source "lotus/drivers/net/Kconfig"

source "lotus/drivers/mtd/Kconfig"

endmenu
```

## source/bootloader/u-boot-2020.01/lotus/drivers/i2c/Kconfig
```kconfig
#
# I2C subsystem configuration
#

menu "LOTUS I2C support"

config LOTUS_I2C
        bool "lotus i2c"
        help
          LOTUS I2C support.

config CMD_LOTUS_I2C
        bool "cmd lotus i2c"
        help
          CMD LOTUS I2C support.

endmenu
```

## source/bootloader/u-boot-2020.01/lotus/drivers/mtd/Kconfig
```kconfig
menu "Flash Controller"

config FMC
	bool "Enable FMC - Flash Memory Controller"
	depends on TARGET_XMFALCON || TARGET_XMORCA
	help
	  lotus Flash Memory Controller support SPI Nor SPI Nand often used on
	  embedded chip. This option will provide the generic support for FMC drivers to register.

source "lotus/drivers/mtd/nand/Kconfig"

source "lotus/drivers/mtd/spi_nor/Kconfig"

config SHOW_FLASH_SPEED
	bool "Show Flash R/W Speed in flash commands"
	default n
	depends on FMC_SPI_NAND || FMC_SPI_NOR || FMC_NAND
	help
	  Support for testing flash speed.

endmenu
```

## source/bootloader/u-boot-2020.01/lotus/drivers/mtd/nand/Kconfig
```kconfig
config FMC_SPI_NAND
	bool "lotus SPI Nand Flash Interface support"
	depends on FMC
	help
	  Enable the lotus SPI Nand flash support.

	  If unsure, say N

config SPI_NAND_MAX_CHIP_NUM
    int "Support max number of SPI Nand flash chip (1, 2)"
	depends on FMC_SPI_NAND
    default 1
    help
      flash memory controller v100 device only support 1 or 2 SPI nand flash
      chip, your should not config other value.

config NAND_MAX_CHIP_NUM
    int "Support max number of Nand flash chip (1, 2)"
	depends on FMC_NAND
    default 1
    help
      flash memory controller v100 device only support 1 or 2 nand flash
      chip, your should not config other value.

if FMC_SPI_NAND || FMC_NAND

choice
    prompt "Page Size and Ecc Type Select"
    default FMC100_AUTO_PAGESIZE_ECC

config FMC100_HARDWARE_PAGESIZE_ECC
    bool "Hardware"
    help
      the configure of page size and ecc type lie on switch on the board.
      so the page size and ecc type is controlled by Hardware see demo
      board of SOC.

config FMC100_AUTO_PAGESIZE_ECC
    bool "Auto"
    help
      auto-sensed the page size and ecc type value. driver will try each of
      page size and ecc type one by one till flash can be read and wrote
      accurately. so the page size and ecc type is match adaptively without
      switch on the board

config FMC100_PAGESIZE_AUTO_ECC_NONE
    bool "Pagesize Auto, Ecc None"
    help
      auto-sensed the page size and select ecc none. driver will try each
      of page size one by one till flash can be read and wrote accurately.
      so the page size is match adaptively without switch on the board

endchoice

endif
```

## source/bootloader/u-boot-2020.01/lotus/drivers/mtd/spi_nor/Kconfig
```kconfig
config FMC_SPI_NOR
	bool "lotus SPI Nor Flash Interface support"
	depends on FMC
	help
	  Enable the lotus SPI Nor flash support.

	  If unsure, say N

config SPI_BLOCK_PROTECT
    bool "Spi Nor Device BP(Block Protect) Support"
	depends on FMC_SPI_NOR
    help
      SFC supports BP(Block Protect) feature to preestablish a series
      area to avoid writing and erasing, except to reading. With this macro
      definition we can get the BP info which was setted before. The
      BOTTOM/TOP bit is setted to BOTTOM, it means the lock area starts
      from 0 address.

	  If unsure, say N

config DTR_MODE_SUPPORT
    bool "Spi Nor Device DTR mode Support"
	depends on FMC_SPI_NOR
	default n
    help
	  To support DTR mode

	  If unsure, say N
```

## source/bootloader/u-boot-2020.01/lotus/drivers/net/Kconfig
```kconfig
menuconfig LOTUS_ETH
	bool "Ethernet Support"
	default y

if LOTUS_ETH

choice
    prompt "Ethernet select"
    default NET_FEMAC

config NET_FEMAC
	bool "Fast Ethernet Controller"
	help
	  This driver supports Fast Ethernet controller.

config FTGMAC030
	bool "Ftgmac030 Ethernet Support"
	help
	  This driver supports Ftgmac030 Ethernet controller.

endchoice

if FTGMAC030
choice
    prompt "FTGMAC030 Soft Version"
    default FTGMAC030_V1

config FTGMAC030_V1
	bool "v1.0"
	help
	  This driver supports Ftgmac030 Ethernet controller.

config FTGMAC030_V2
	bool "v2.0"
	select PHYLIB
	select MII
	help
	  This driver supports Ftgmac030 Ethernet controller.

endchoice
endif

endif
```

## source/bootloader/u-boot-2020.01/lotus/drivers/usb/Kconfig
```kconfig
menuconfig LOTUS_USB
	bool "LOTUS USB support"
	default y
	select CMD_USB
	select USB
	help
	  LOTUS USB support.

if LOTUS_USB
config USB_PWREN_OFF_DELAY
	int "usb port power off delay(ms)"
	default 100
	help
	  Some usb device can't be recognize in U-boot because of error state, so
	  we power off them and wait a delay to restart them, we call the delay
	  as USB_PWREN_OFF_DELAY.

config USB_DUAL_PORT_SUPPORT
	bool "support dual-usb-port(U2 & U3) in host mode"
	default n
	help
	  Some lotus chips support 2 usb host ports, contains U2 and U3. If your
	  chip support 2 ports, enable this config could recognize U3 and U2 dev
	  meanwhile, but cause to U3 couldn't be recognized sometimes.
endif
```

## source/bootloader/u-boot-2020.01/lotus/machine/Kconfig
```kconfig
choice
	prompt "Target select"
	default TARGET_XMFALCON

config TARGET_XMFALCON
	bool "Support xmfalcon"
	select CPU_V7A
	select DM
	select CPU_V7A_HAS_NONSEC
	help
	Support for lotus xmfalcon platform.

config TARGET_XMORCA
	bool "Support xmorca"
	select CPU_V7A
	select DM
	select CPU_V7A_HAS_NONSEC
	help
	Support for lotus xmorca platform.

config TARGET_XMORCA
	bool "Support xmorca"
	select CPU_V7A
	select DM
	select CPU_V7A_HAS_NONSEC
	help
	Support for lotus xmorca platform.

endchoice

source "lotus/machine/xmfalcon/Kconfig"
source "lotus/machine/xmorca/Kconfig"
```

## source/bootloader/u-boot-2020.01/lotus/machine/xmfalcon/Kconfig
```kconfig
if TARGET_XMFALCON

# config SYS_BOARD
#         default "xmfalcon"
#
# config SYS_VENDOR
#         default "lotus"

config SYS_SOC
	default "xmfalcon"

config SYS_CONFIG_NAME
	default "xmfalcon"

endif
```

## source/bootloader/u-boot-2020.01/lotus/machine/xmorca/Kconfig
```kconfig
if TARGET_XMORCA

# config SYS_BOARD
#         default "xmorca"
#
# config SYS_VENDOR
#         default "lotus"

config SYS_SOC
	default "xmorca"

config SYS_CONFIG_NAME
	default "xmorca"

endif
```
